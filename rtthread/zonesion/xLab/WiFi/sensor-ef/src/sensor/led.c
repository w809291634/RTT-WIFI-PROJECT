/*********************************************************************************************
* 文件：led.c
* 作者：Meixin 2017.09.15
* 说明：LED灯驱动代码     
* 修改：liutong 20171027 修改了LED控制引脚初始化函数名称、优化了注释、增加了LED打开和关闭函数
* 注释：
*********************************************************************************************/

/*********************************************************************************************
* 头文件
*********************************************************************************************/
#include "led.h"
#include "stm32f10x.h"
/*********************************************************************************************
* 名称：ext_led_init()
* 功能：LED控制引脚初始化
* 参数：无
* 返回：无
* 修改：
* 注释：
*********************************************************************************************/
void ext_led_init(void)
{
  GPIO_InitTypeDef  GPIO_InitStructure;
 	
  RCC_APB2PeriphClockCmd(RCC_APB2Periph_GPIOA, ENABLE);	 //使能PA端口时钟
  GPIO_InitStructure.GPIO_Pin = GPIO_Pin_7 | GPIO_Pin_6;
  GPIO_InitStructure.GPIO_Speed = GPIO_Speed_2MHz;
  GPIO_InitStructure.GPIO_Mode = GPIO_Mode_Out_PP;
  GPIO_Init(GPIOA, &GPIO_InitStructure);	
  led_off(0x01);                                                     //初始状态为关闭
  led_off(0x02);
  
}
  
/*********************************************************************************************
* 名称：ext_led_on()
* 功能：LED控制打开函数
* 参数：LED号，在led.h中宏定义为LED1，LED2
* 返回：0，打开LED成功，-1，参数错误
* 修改：
* 注释：参数只能填入LED1，LED2,否则会返回-1
*********************************************************************************************/
signed char ext_led_on(unsigned char led)
{
  if(led & 0x01){                                                //如果要打开LED1
    GPIO_ResetBits(LED_port,LED1);
    return 0;
  }
    
  if(led & 0x02){                                                //如果要打开LED2
    GPIO_ResetBits(LED_port,LED2);
    return 0;
  }
  
  return -1;                                                    //参数错误，返回-1
}

/*********************************************************************************************
* 名称：ext_led_off()
* 功能：LED控制关闭函数
* 参数：LED号，在led.h中宏定义为LED1，LED2
* 返回：0，关闭LED成功，-1，参数错误
* 修改：
* 注释：参数只能填入LED1，LED2,否则会返回-1
*********************************************************************************************/
signed char ext_led_off(unsigned char led)
{
  if(led &0x01){                                                //如果要关闭LED1
    GPIO_SetBits(LED_port,LED1);
    return 0;
  }
    
  if(led &0x2){                                                //如果要关闭LED2
    GPIO_SetBits(LED_port,LED2);
    return 0;
  }
  
  return -1;                                                    //参数错误，返回-1
}